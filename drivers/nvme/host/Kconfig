## drivers/nvme/host/Kconfig
```kconfig
config BLK_DEV_NVME
	tristate "NVM Express block device"
	depends on PCI
	---help---
	  The NVM Express driver is for solid state drives directly
	  connected to the PCI or PCI Express bus.  If you know you
	  don't have one of these, it is safe to answer N.

	  To compile this driver as a module, choose M here: the
	  module will be called nvme.

config VIRTIO_NVME
	tristate "Virtio NVMe driver"
	depends on VIRTIO
	---help---
	  This is the virtual NVMe driver for virtio.  It can be used with
          lguest or QEMU based VMMs (like KVM or Xen).  Say Y or M.
```

## drivers/target/tcm_aoe/Kconfig
```kconfig
config TCM_AOE
	tristate "TCM_AOE fabric Plugin"
	help
	Say Y here to enable the TCM AoE plugin for accessing ATA fabrics in TCM
```
